## config/boards/shields/patch78/Kconfig.defconfig
```kconfig
# Copyright (c) 2020 The ZMK Contributors
# SPDX-License-Identifier: MIT

if SHIELD_PATCH78_LEFT

config ZMK_KEYBOARD_NAME
    default "patch78"

config ZMK_SPLIT_ROLE_CENTRAL
    default y

endif

if SHIELD_PATCH78_LEFT || SHIELD_PATCH78_RIGHT

config ZMK_SPLIT
    default y

endif
```

## config/boards/shields/patch78/Kconfig.shield
```kconfig
# Copyright (c) 2020 The ZMK Contributors
# SPDX-License-Identifier: MIT

config SHIELD_PATCH78_LEFT
    def_bool $(shields_list_contains,patch78_left)

config SHIELD_PATCH78_RIGHT
    def_bool $(shields_list_contains,patch78_right)
```
